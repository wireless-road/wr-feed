// SPDX-License-Identifier: GPL-2.0-only
/*
 * Copyright (C) 2023 WirelessRoad
 */

#include "wr-common.dtsi"
/ {
    sound {
		compatible = "simple-audio-card";
		simple-audio-card,name = "mx6ul-wm8960";
		simple-audio-card,format = "i2s";
		simple-audio-card,bitclock-master = <&dailink_master>;
		simple-audio-card,frame-master = <&dailink_master>;
		simple-audio-card,widgets =
			"Microphone", "Mic Jack",
			"Line", "Line In",
			"Line", "Line Out",
			"Speaker", "Speaker",
			"Headphone", "Headphone Jack";
		simple-audio-card,routing =
			"Headphone Jack", "HP_L",
			"Headphone Jack", "HP_R",
			"Speaker", "SPK_LP",
			"Speaker", "SPK_LN",
			"Speaker", "SPK_RP",
			"Speaker", "SPK_RN",
			"LINPUT1", "Mic Jack",
			"LINPUT2", "Mic Jack",
			"RINPUT2", "Line In";

		simple-audio-card,cpu {
			sound-dai = <&sai2>;
		};

		dailink_master: simple-audio-card,codec {
			sound-dai = <&codec>;
			clocks = <&clks IMX6UL_CLK_SAI2>;
		};
	};
};

&clks {
	assigned-clocks = <&clks IMX6UL_CLK_PLL4_AUDIO_DIV>;
	assigned-clock-rates = <786432000>;
};

&i2c1 {
	status = "okay";
	
    codec: wm8960@1a {
		#sound-dai-cells = <0>;
		compatible = "wlf,wm8960";
		reg = <0x1a>;
		wlf,shared-lrclk;
	};
};

&iomuxc {
    pinctrl_sai2: sai2grp {
			fsl,pins = <
				MX6UL_PAD_JTAG_TDI__SAI2_TX_BCLK    0x17088
				MX6UL_PAD_JTAG_TDO__SAI2_TX_SYNC    0x17088
				MX6UL_PAD_JTAG_TRST_B__SAI2_TX_DATA 0x11088
				MX6UL_PAD_JTAG_TCK__SAI2_RX_DATA    0x11088
				MX6UL_PAD_JTAG_TMS__SAI2_MCLK       0x17088
			>;
		};
};

&sai2 {
    status = "okay"
};

